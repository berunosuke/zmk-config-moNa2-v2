## config/west.yml
```yaml
manifest:
  remotes:
    - name: zmkfirmware
      url-base: https://github.com/zmkfirmware
    - name: sayu-hub
      url-base: https://github.com/sayu-hub
    - name: badjeff    # <-- PMW3610
      url-base: https://github.com/badjeff
    # - name: sekigon-gonnoc  # <-- PAW3222
    #   url-base: https://github.com/sekigon-gonnoc
    - name: caksoylar  # <-- RGB LED
      url-base: https://github.com/caksoylar
    - name: zettaface  # <-- Input Processor Keybind
      url-base: https://github.com/zettaface
    - name: urob
      url-base: https://github.com/urob
    - name: dhruvinsh
      url-base: https://github.com/dhruvinsh
  projects:
    - name: zmk
      remote: zmkfirmware
      revision: v0.3-branch
      import: app/west.yml
    - name: zmk-pmw3610-driver
      remote: badjeff
      revision: zmk-0.3
    # - name: zmk-driver-paw3222
    #   remote: sekigon-gonnoc
    #   revision: main
    - name: zmk-rgbled-widget
      remote: caksoylar
      revision: v0.3-branch
    - name: zmk-input-processor-keybind
      remote: zettaface
      revision: main
    - name: zmk-auto-layer
      remote: urob
      revision: v0.3
    - name: zmk-leader-key
      remote: urob
      revision: v0.3
    - name: zmk-helpers
      remote: urob
      revision: v0.3
    - name: zmk-tri-state
      remote: dhruvinsh
      revision: main
    - name: zmk-input-processor-report-rate-limit
      remote: badjeff
      revision: main
      
  self:
    path: config
```
